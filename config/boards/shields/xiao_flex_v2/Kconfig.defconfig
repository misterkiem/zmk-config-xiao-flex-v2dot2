## config/boards/shields/xiao_flex_v2/Kconfig.defconfig
```kconfig
if SHIELD_XIAO_FLEX_V2_LEFT

config ZMK_KEYBOARD_NAME
    default "skree_customs"

config ZMK_SPLIT_ROLE_CENTRAL
    default y

endif

if SHIELD_XIAO_FLEX_V2

config ZMK_SPLIT
    default y

endif
```
